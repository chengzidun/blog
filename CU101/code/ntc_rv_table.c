#include "ntc_rv_table.h"
#include "adcx.h"

#define TABLE_SIZE  			181
#define ADC1_CONVDATA_SIZE		8

//NTC-10K-3950-B值
//-55~125摄氏度对应的电阻阻值表(单位:Ω)
//阻值-温度换算:  数组下标索引减去55即为温度值
const u32 g_rvTable[TABLE_SIZE] = {
	1034600, 959006, 889452, 825419, 766434, 											//-55~-51
	712066, 661926, 615656, 572934, 533466, 496983, 463240, 432015, 403104, 376320, 	//-50~-41
	351495, 328472, 307110, 287279, 268859, 251741, 235826, 221021, 207242, 194412, 	//-40~-31
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	374, 364, 355, 345, 337																//121~125
};

/**
 * @brief 中值滤波
 * @param collection: 元素集合
 * @param size: 集合大小
 * @retval 中值
 */
u16 mid_filter(u16 *collection, u16 size)
{
	u16 e;
	u16 i, j;
	u8 sorted;
	
	i = 0;
	while(i < size - 1){//冒泡的趟数 
		sorted = 1;
		j = 0;
		while(j < size - 1 - i){//一趟冒的次数 
			
			if(collection[j] > collection[j + 1]){
				e = collection[j];
				collection[j] = collection[j + 1];
				collection[j + 1] = e;
				sorted = 0;
			}
			
			j++;
		}
		if(sorted) break;
		
		i++;
	}
	
	return collection[size / 2];
}

s8 ntc_get_temp(void)
{
	s16 i;
	u32 adcValue;
	float rValue;
	s8 temperature;
	u16 adc_buffer[ADC1_CONVDATA_SIZE];
	
	for(i = 0; i < ADC1_CONVDATA_SIZE; i++)
		adc_buffer[i] = GetAdcAverage(5);

	adcValue = mid_filter(adc_buffer, ADC1_CONVDATA_SIZE);
	rValue = 4095000.0;
	rValue = rValue / adcValue - 1000;
	adcValue = 10000000.0 / rValue;
	for(i = 0; i < TABLE_SIZE; i++) {
		if(adcValue > g_rvTable[i]) {
			temperature = i - 55;
			break;
		}
	}		

	return temperature;
}
